## config/boards/shields/over_heart/Kconfig.defconfig
```kconfig
if SHIELD_OVER_HEART_LEFT

config ZMK_KEYBOARD_NAME
    default "Over Heart"

config ZMK_SPLIT_ROLE_CENTRAL
    default y

endif

if SHIELD_OVER_HEART_LEFT || SHIELD_OVER_HEART_RIGHT

config ZMK_SPLIT
    default y

endif
```

## config/boards/shields/over_heart/Kconfig.shield
```kconfig
config SHIELD_OVER_HEART_LEFT
    def_bool $(shields_list_contains,over_heart_left)

config SHIELD_OVER_HEART_RIGHT
    def_bool $(shields_list_contains,over_heart_right)
```
